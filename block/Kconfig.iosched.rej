## block/Kconfig.iosched.rej
```kconfig
--- block/Kconfig.iosched
+++ block/Kconfig.iosched
@@ -66,14 +66,21 @@
 	  bfqio.
 
 config IOSCHED_SIO
-        tristate "Simple I/O scheduler"
-        default y
-        ---help---
-          The Simple I/O scheduler is an extremely simple scheduler,
-          based on noop and deadline, that relies on deadlines to
-          ensure fairness. The algorithm does not do any sorting but
-          basic merging, trying to keep a minimum overhead. It is aimed
-          mainly for aleatory access devices (eg: flash devices).
+	tristate "Simple I/O scheduler"
+	default y
+	---help---
+	  The Simple I/O scheduler is an extremely simple scheduler,
+	  based on noop and deadline, that relies on deadlines to
+	  ensure fairness. The algorithm does not do any sorting but
+	  basic merging, trying to keep a minimum overhead. It is aimed
+	  mainly for aleatory access devices (eg: flash devices).
+
+config IOSCHED_VR
+	tristate "V(R) I/O scheduler"
+	default y
+	---help---
+	  Requests are chosen according to SSTF with a penalty of rev_penalty
+	  for switching head direction.
 
 choice
 	prompt "Default I/O scheduler"
```
